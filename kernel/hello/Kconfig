## kernel/hello/Kconfig
```kconfig
config HELLO  

   tristate "Hello World for fengyuwuzu"  

   help  

     Hello  forfengyuwuzu  
```

## kernel/hello2/Kconfig
```kconfig
config HELLO2  

   tristate "Hello2 driver for panzq"  

   help  

     hello world 2 !  
```
